## conf/layer.conf
```bitbake
# We have a conf and classes directory, append to BBPATH
BBPATH .= ":${LAYERDIR}"

# We have a recipes directory, add to BBFILES
BBFILES += "${LAYERDIR}/recipes*/*/*.bb ${LAYERDIR}/recipes*/*/*.bbappend"

BBFILE_COLLECTIONS += "meta-sunlab"
BBFILE_PATTERN_meta-sunlab := "^${LAYERDIR}/"
BBFILE_PRIORITY_meta-sunlab = "90"
```
